## sdkconfig.defaults
```kconfig
# ESP32-S3 target
CONFIG_IDF_TARGET="esp32s3"

# PSRAM (8MB onboard)
CONFIG_SPIRAM=y
CONFIG_SPIRAM_MODE_OCT=y
CONFIG_SPIRAM_SPEED_80M=y

# WiFi
CONFIG_ESP_WIFI_SOFTAP_SUPPORT=n

# HTTP client
CONFIG_ESP_HTTP_CLIENT_ENABLE_HTTPS=n
CONFIG_HTTPD_MAX_REQ_HDR_LEN=1024

# Audio buffer in PSRAM
CONFIG_SPIRAM_ALLOW_STACK_EXTERNAL_MEMORY=y

# Partition table
CONFIG_PARTITION_TABLE_SINGLE_APP_LARGE=y
```
